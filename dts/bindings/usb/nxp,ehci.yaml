## dts/bindings/usb/nxp,ehci.yaml
```yaml
# Copyright 2023 NXP
# SPDX-License-Identifier: Apache-2.0

description: NXP EHCI USB device mode

compatible: nxp,ehci

include: ["nxp,mcux-usbd.yaml", "nxp,rdc-policy.yaml"]

properties:
  phy-handle:
    type: phandle
```
