## prj.conf
```kconfig
CONFIG_USB_DEVICE_STACK_NEXT=y

CONFIG_STDOUT_CONSOLE=y
CONFIG_SERIAL=y
CONFIG_UART_LINE_CTRL=y
CONFIG_USBD_CDC_ACM_CLASS=y
CONFIG_CDC_ACM_SERIAL_INITIALIZE_AT_BOOT=n

CONFIG_LOG=y
CONFIG_USBD_LOG_LEVEL_ERR=y
CONFIG_UDC_DRIVER_LOG_LEVEL_DBG=y
CONFIG_USBD_CDC_ACM_LOG_LEVEL_DBG=y

CONFIG_SAMPLE_USBD_PID=0x0420
CONFIG_SAMPLE_USBD_PRODUCT="USBD my own CDC sample"

CONFIG_WATCHDOG=y

CONFIG_EARLY_CONSOLE=y
#CONFIG_WDT_TIMEOUT_MSEC=5000

#CONFIG_UDC_BUF_FORCE_NOCACHE=n
#CONFIG_DCACHE_LINE_SIZE_DETECT=n
#CONFIG_DCACHE_LINE_SIZE=64

CONFIG_REBOOT=y
CONFIG_SHELL=y
CONFIG_NOCACHE_MEMORY=n

CONFIG_THREAD_STACK_INFO=y
CONFIG_INIT_STACKS=y
CONFIG_STACK_SENTINEL=y
# If supported on your SoC:
CONFIG_HW_STACK_PROTECTION=y
CONFIG_UDC_WORKQUEUE_STACK_SIZE=8192
CONFIG_USBD_THREAD_STACK_SIZE=8192
CONFIG_USBD_CDC_ACM_WORKQUEUE=y
CONFIG_USBD_CDC_ACM_STACK_SIZE=8192
```

## app.overlay
```dts
/*
 * Copyright (c) 2021 Nordic Semiconductor ASA
 *
 * SPDX-License-Identifier: Apache-2.0
 */

&zephyr_udc0 {
	cdc_acm_uart0 {
		compatible = "zephyr,cdc-acm-uart";
		label = "Zephyr USB CDC-ACM";
	};

	status = "okay";
};

&wdog1 {
	status = "okay";
};
```

## src/main.c
```c
/*
 * Copyright (c) 2019 Intel Corporation
 *
 * SPDX-License-Identifier: Apache-2.0
 */

#include <sample_usbd.h>

#include <stdio.h>
#include <string.h>
#include <zephyr/device.h>
#include <zephyr/drivers/uart.h>
#include <zephyr/kernel.h>
#include <zephyr/sys/ring_buffer.h>

#if DT_NODE_HAS_STATUS_OKAY(DT_NODELABEL(wdog1))
#include <zephyr/drivers/watchdog.h>
#include <fsl_wdog.h>
#endif

#include <zephyr/usb/usbd.h>
#include <zephyr/logging/log.h>
LOG_MODULE_REGISTER(cdc_acm_echo, LOG_LEVEL_INF);

const struct device *const uart_dev = DEVICE_DT_GET_ONE(zephyr_cdc_acm_uart);

#define RING_BUF_SIZE 1024
uint8_t ring_buffer[RING_BUF_SIZE];

struct ring_buf ringbuf;

static bool rx_throttled;

static inline void print_baudrate(const struct device *dev)
{
	uint32_t baudrate;
	int ret;

	ret = uart_line_ctrl_get(dev, UART_LINE_CTRL_BAUD_RATE, &baudrate);
	if (ret) {
		LOG_WRN("Failed to get baudrate, ret code %d", ret);
	} else {
		LOG_INF("Baudrate %u", baudrate);
	}
}

static struct usbd_context *sample_usbd;
K_SEM_DEFINE(dtr_sem, 0, 1);

static void sample_msg_cb(struct usbd_context *const ctx, const struct usbd_msg *msg)
{
	LOG_INF("USBD message: %s", usbd_msg_type_string(msg->type));

	if (usbd_can_detect_vbus(ctx)) {
		if (msg->type == USBD_MSG_VBUS_READY) {
			if (usbd_enable(ctx)) {
				LOG_ERR("Failed to enable device support");
			}
		}

		if (msg->type == USBD_MSG_VBUS_REMOVED) {
			if (usbd_disable(ctx)) {
				LOG_ERR("Failed to disable device support");
			}
		}
	}

	if (msg->type == USBD_MSG_CDC_ACM_CONTROL_LINE_STATE) {
		uint32_t dtr = 0U;

		uart_line_ctrl_get(msg->dev, UART_LINE_CTRL_DTR, &dtr);
		if (dtr) {
			k_sem_give(&dtr_sem);
		}
	}

	if (msg->type == USBD_MSG_CDC_ACM_LINE_CODING) {
		print_baudrate(msg->dev);
	}
}

static int enable_usb_device_next(void)
{
	int err;

	sample_usbd = sample_usbd_init_device(sample_msg_cb);
	if (sample_usbd == NULL) {
		LOG_ERR("Failed to initialize USB device");
		return -ENODEV;
	}

	if (!usbd_can_detect_vbus(sample_usbd)) {
		err = usbd_enable(sample_usbd);
		if (err) {
			LOG_ERR("Failed to enable device support");
			return err;
		}
	}

	LOG_INF("USB device support enabled");

	return 0;
}

static void interrupt_handler(const struct device *dev, void *user_data)
{
	ARG_UNUSED(user_data);

	printk("usbirq\n");
	while (uart_irq_update(dev) && uart_irq_is_pending(dev)) {
		if (!rx_throttled && uart_irq_rx_ready(dev)) {
			int recv_len, rb_len;
			uint8_t buffer[64];
			size_t len = MIN(ring_buf_space_get(&ringbuf),
					 sizeof(buffer));

			if (len == 0) {
				/* Throttle because ring buffer is full */
				uart_irq_rx_disable(dev);
				rx_throttled = true;
				continue;
			}

			recv_len = uart_fifo_read(dev, buffer, len);
			if (recv_len < 0) {
				LOG_ERR("Failed to read UART FIFO");
				recv_len = 0;
			};

			rb_len = ring_buf_put(&ringbuf, buffer, recv_len);
			if (rb_len < recv_len) {
				LOG_ERR("Drop %u bytes", recv_len - rb_len);
			}

			LOG_DBG("tty fifo -> ringbuf %d bytes", rb_len);
			if (rb_len) {
				uart_irq_tx_enable(dev);
			}
		}

		if (uart_irq_tx_ready(dev)) {
			uint8_t buffer[64];
			int rb_len, send_len;

			rb_len = ring_buf_get(&ringbuf, buffer, sizeof(buffer));
			if (!rb_len) {
				LOG_DBG("Ring buffer empty, disable TX IRQ");
				uart_irq_tx_disable(dev);
				continue;
			}

			if (rx_throttled) {
				uart_irq_rx_enable(dev);
				rx_throttled = false;
			}

			send_len = uart_fifo_fill(dev, buffer, rb_len);
			if (send_len < rb_len) {
				LOG_ERR("Drop %d bytes", rb_len - send_len);
			}

			LOG_DBG("ringbuf -> tty fifo %d bytes", send_len);
		}
	}
}
#if DT_NODE_HAS_STATUS_OKAY(DT_NODELABEL(wdog1))
const struct device *wdt = DEVICE_DT_GET(DT_NODELABEL(wdog1));

void watchdog_feed() { wdt_feed(wdt, 0); }

void wdt_callback(const struct device *dev, int channel_id) {
    watchdog_feed();  // Have to feed once, otherwise we'll reset immediately.
    printk("\nWDT_TRIGGERED\n");
    sys_reset();
}

void sys_reset() {

    printk("\nSYS_RESET\n");
    k_busy_wait(1000);

    barrier_dsync_fence_full();  // Flush all pending writes to memory.

    WDOG_TriggerSystemSoftwareReset((WDOG_Type *)WDOG1_BASE);
}
#endif

int main(void)
{
	int ret;

	printk("hello from main!\n");
	#if DT_NODE_HAS_STATUS_OKAY(DT_NODELABEL(wdog1))
	int handle = wdt_install_timeout(wdt, &(struct wdt_timeout_cfg){
		.window = { .min = 0, .max = 5000 },
		.callback = wdt_callback,
	});
	printk("wdog handle %d\n", handle);
//	wdt_setup(wdt, WDT_OPT_PAUSE_HALTED_BY_DBG);
	#endif

	if (!device_is_ready(uart_dev)) {
		LOG_ERR("CDC ACM device not ready");
		return 0;
	}

	printk("Hello\n");
	ret = enable_usb_device_next();
	if (ret != 0) {
		LOG_ERR("Failed to enable USB device support");
		return 0;
	}

	printk("Hello2\n");
	ring_buf_init(&ringbuf, sizeof(ring_buffer), ring_buffer);
	printk("Hello3\n");
	LOG_INF("Wait for DTR");
	k_sem_take(&dtr_sem, K_FOREVER);
	LOG_INF("DTR set");
	printk("dev name %s\n", uart_dev->name);

	/* They are optional, we use them to test the interrupt endpoint */
	ret = uart_line_ctrl_set(uart_dev, UART_LINE_CTRL_DCD, 1);
	if (ret) {
		LOG_WRN("Failed to set DCD, ret code %d", ret);
	}

	printk("setting linectrl\n");

	ret = uart_line_ctrl_set(uart_dev, UART_LINE_CTRL_DSR, 1);
	if (ret) {
		LOG_WRN("Failed to set DSR, ret code %d", ret);
	}

	printk("sleep\n");

	/* Wait 100ms for the host to do all settings */
	k_msleep(100);

	printk("setting irqhandler\n");
	uart_irq_callback_set(uart_dev, interrupt_handler);
	/* Enable rx interrupts */
	uart_irq_rx_enable(uart_dev);

	printk("enabled rx\n");
	return 0;
}
```
